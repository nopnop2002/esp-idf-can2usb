## sdkconfig.defaults
```kconfig
#
# Supplicant
#
CONFIG_TINYUSB=y
CONFIG_TINYUSB_CDC_ENABLED=y

#
# Partition Table
#
CONFIG_PARTITION_TABLE_CUSTOM=y
CONFIG_PARTITION_TABLE_CUSTOM_FILENAME="partitions.csv"
CONFIG_PARTITION_TABLE_FILENAME="partitions.csv"
```
